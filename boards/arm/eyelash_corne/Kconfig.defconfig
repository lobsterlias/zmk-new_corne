## boards/arm/eyelash_corne/Kconfig.defconfig
```kconfig
#
# Copyright (c) 2024 The ZMK Contributors
# SPDX-License-Identifier: MIT
#

if BOARD_EYELASH_CORNE_LEFT

config ZMK_KEYBOARD_NAME
    default "lias Corne"

config ZMK_SPLIT_ROLE_CENTRAL
    default y

endif # BOARD_EYELASH_CORNE_LEFT

if BOARD_EYELASH_CORNE_LEFT || BOARD_EYELASH_CORNE_RIGHT

config BOARD
    default "eyelash_corne"

config BOARD_ENABLE_DCDC
    bool "Enable DCDC mode"
    select SOC_DCDC_NRF52X
    default y

config BOARD_ENABLE_DCDC_HV
    bool "Enable High Voltage DCDC converter"
    default y
    select SOC_DCDC_NRF52X_HV
    depends on (BOARD_EYELASH_CORNE_LEFT || BOARD_EYELASH_CORNE_RIGHT)

config ZMK_SLEEP
    default y

config ZMK_SPLIT
    default y

config BT_CTLR
    default BT

if USB

config USB_NRFX
    default y

config USB_DEVICE_STACK
    default y

endif # USB

if ZMK_BACKLIGHT

config PWM
    default y

config LED_PWM
    default y

endif # ZMK_BACKLIGHT

config EC11
    bool "EC11 encoder support"
    default y

config EC11_TRIGGER_GLOBAL_THREADS
    bool "EC11 encoder trigger global threads"
    default y

if EC11

config ENCODER_DEFAULT_RESOLUTION
    int "Default number of pulses per step"
    default 4

endif # EC11

endif # BOARD_EYELASH_CORNE_LEFT || BOARD_EYELASH_CORNE_RIGHT
```
